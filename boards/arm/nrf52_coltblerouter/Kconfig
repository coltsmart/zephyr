## boards/arm/nrf52_coltblerouter/Kconfig
```kconfig
# Kconfig - nRF52 Coltblerouter board configuration
#
# Copyright (c) 2017 VNG IoT Lab
#
# SPDX-License-Identifier: Apache-2.0

if BOARD_NRF52_COLTBLEROUTER

config BOARD_ENABLE_DCDC
	bool "Enable DCDC mode"
	select SOC_DCDC_NRF52X
	default y

endif # BOARD_NRF52_COLTBLEROUTER
```

## boards/arm/nrf52_coltblerouter/Kconfig.board
```kconfig
# Kconfig - nRF52 Coltblerouter board configuration
#
# Copyright (c) 2017 VNG IoT Lab
#
# SPDX-License-Identifier: Apache-2.0

config  BOARD_NRF52_COLTBLEROUTER
	bool "nRF52 Coltblerouter"
	depends on SOC_NRF52832_QFAA
```

## boards/arm/nrf52_coltblerouter/Kconfig.defconfig
```kconfig
# Kconfig - nRF52 Coltblerouter board configuration
#
# Copyright (c) 2017 VNG IoT Lab
#
# SPDX-License-Identifier: Apache-2.0

if BOARD_NRF52_COLTBLEROUTER

config BOARD
	default "nrf52_coltblerouter"

endif # BOARD_NRF52_COLTBLEROUTER
```

## boards/arm/nrf52_coltblerouter/nrf52_coltblerouter_defconfig
```kconfig
CONFIG_ARM=y
CONFIG_SOC_FAMILY_NRF=y
CONFIG_SOC_SERIES_NRF52X=y
CONFIG_SOC_NRF52832_QFAA=y
CONFIG_BOARD_NRF52_COLTBLEROUTER=y
# Enable MPU
CONFIG_ARM_MPU=y

# enable uart driver
CONFIG_SERIAL=y
CONFIG_UART_NRFX=y
CONFIG_UART_0_NRF_UART=y

# enable console
CONFIG_CONSOLE=y
CONFIG_UART_CONSOLE=y

# additional board options
CONFIG_GPIO_AS_PINRESET=y

# bluetooth
CONFIG_BT=y
CONFIG_BT_CTLR=y

# Enable SPI
CONFIG_SPI=y
CONFIG_NRFX_SPI=y
# CONFIG_SPI_ASYNC is not set
# CONFIG_SPI_SLAVE is not set
CONFIG_SPI_INIT_PRIORITY=70
CONFIG_SPI_0=y
CONFIG_SPI_0_OP_MODES=1
# CONFIG_SPI_1 is not set
# CONFIG_SPI_2 is not set
# CONFIG_SPI_3 is not set
# CONFIG_SPI_4 is not set
# CONFIG_SPI_5 is not set
# CONFIG_SPI_DW is not set
CONFIG_SPI_NRFX=y
CONFIG_SPI_0_NRF_SPI=y
CONFIG_SPI_0_NRF_ORC=0xff

#
# Networking
#
CONFIG_NET_BUF=y
CONFIG_NET_BUF_USER_DATA_SIZE=4
# CONFIG_NET_BUF_LOG is not set
# CONFIG_NET_BUF_POOL_USAGE is not set
CONFIG_NETWORKING=y
# CONFIG_NET_HOSTNAME_ENABLE is not set

#
# Link layer options
#
# CONFIG_NET_L2_DUMMY is not set
# CONFIG_NET_L2_BT is not set
# CONFIG_NET_L2_BT_SHELL is not set
CONFIG_NET_L2_ETHERNET=y
# CONFIG_NET_L2_ETHERNET_MGMT is not set
# CONFIG_NET_VLAN is not set
CONFIG_NET_ARP=y
CONFIG_NET_ARP_TABLE_SIZE=2
# CONFIG_NET_GPTP is not set

#
# Link Layer Discovery Protocol (LLDP) options
#
# CONFIG_NET_LLDP is not set
# CONFIG_NET_L2_WIFI_MGMT is not set
# CONFIG_NET_L2_WIFI_SHELL is not set

#
# IP stack
#
CONFIG_NET_INIT_PRIO=90
# CONFIG_NET_LOG=4
# CONFIG_NET_IPV6 is not set
CONFIG_NET_IPV4=y
CONFIG_NET_INITIAL_TTL=64
CONFIG_NET_IF_MAX_IPV4_COUNT=1
CONFIG_NET_IF_UNICAST_IPV4_ADDR_COUNT=2
CONFIG_NET_IF_MCAST_IPV4_ADDR_COUNT=1
CONFIG_NET_DHCPV4=y
CONFIG_NET_IPV4_AUTO=y
# CONFIG_NET_SHELL is not set
CONFIG_NET_TC_TX_COUNT=1
CONFIG_NET_TC_RX_COUNT=1
CONFIG_NET_TC_MAPPING_STRICT=y
CONFIG_NET_TX_DEFAULT_PRIORITY=1
CONFIG_NET_IP_ADDR_CHECK=y
CONFIG_NET_MAX_ROUTERS=1
CONFIG_NET_TCP=y
CONFIG_NET_TCP_CHECKSUM=y
CONFIG_NET_TCP_BACKLOG_SIZE=1
CONFIG_NET_TCP_TIME_WAIT_DELAY=250
CONFIG_NET_TCP_ACK_TIMEOUT=1000
CONFIG_NET_TCP_INIT_RETRANSMISSION_TIMEOUT=200
CONFIG_NET_TCP_RETRY_COUNT=9
CONFIG_NET_UDP=y
CONFIG_NET_UDP_CHECKSUM=y
CONFIG_NET_MAX_CONN=4
# CONFIG_NET_CONN_CACHE is not set
CONFIG_NET_MAX_CONTEXTS=6
# CONFIG_NET_CONTEXT_NET_PKT_POOL is not set
CONFIG_NET_CONTEXT_SYNC_RECV=y
CONFIG_NET_CONTEXT_CHECK=y
# CONFIG_NET_CONTEXT_PRIORITY is not set
# CONFIG_NET_TEST is not set
# CONFIG_NET_SLIP_TAP is not set
# CONFIG_NET_TRICKLE is not set
CONFIG_NET_PKT_RX_COUNT=14
CONFIG_NET_PKT_TX_COUNT=14
CONFIG_NET_BUF_RX_COUNT=36
CONFIG_NET_BUF_TX_COUNT=36
CONFIG_NET_BUF_DATA_SIZE=128
CONFIG_NET_DEFAULT_IF_FIRST=y
# CONFIG_NET_DEFAULT_IF_ETHERNET is not set
# CONFIG_NET_PKT_TIMESTAMP is not set
# CONFIG_NET_PROMISCUOUS_MODE is not set

#
# Stack usage
#
CONFIG_NET_TX_STACK_SIZE=1200
CONFIG_NET_RX_STACK_SIZE=1500
CONFIG_NET_RX_STACK_RPL=0
CONFIG_NET_MGMT=y
CONFIG_NET_MGMT_EVENT=y
CONFIG_NET_MGMT_EVENT_STACK_SIZE=512
CONFIG_NET_MGMT_EVENT_THREAD_PRIO=7
CONFIG_NET_MGMT_EVENT_QUEUE_SIZE=2
# CONFIG_NET_MGMT_EVENT_INFO is not set
# CONFIG_NET_DEBUG_MGMT_EVENT is not set
# CONFIG_NET_DEBUG_MGMT_EVENT_STACK is not set
# CONFIG_NET_RPL is not set
# CONFIG_NET_STATISTICS is not set
# CONFIG_NET_OFFLOAD is not set

#
# Network Protocols
#
# CONFIG_COAP is not set
CONFIG_COAP_INIT_ACK_TIMEOUT_MS=2345
# CONFIG_DNS_RESOLVER is not set
CONFIG_MQTT_LIB=y
CONFIG_MQTT_MSG_MAX_SIZE=128
CONFIG_MQTT_ADDITIONAL_BUFFER_CTR=0
CONFIG_MQTT_SUBSCRIBE_MAX_TOPICS=1
CONFIG_MQTT_LIB_TLS=n
# CONFIG_HTTP is not set
# CONFIG_HTTP_PARSER is not set
# CONFIG_HTTP_PARSER_URL is not set
# CONFIG_LWM2M is not set
# CONFIG_SNTP is not set

#
# Network Libraries
#
CONFIG_NET_CONFIG_AUTO_INIT=y
CONFIG_NET_CONFIG_INIT_PRIO=95
CONFIG_NET_CONFIG_INIT_TIMEOUT=30
# CONFIG_NET_CONFIG_NEED_IPV6 is not set
CONFIG_NET_CONFIG_NEED_IPV4=y
# CONFIG_NET_DEBUG_CONFIG is not set
# CONFIG_NET_CONFIG_SETTINGS is not set
CONFIG_NET_APP=y
# CONFIG_NET_DEBUG_APP is not set
# CONFIG_NET_APP_SERVER is not set
CONFIG_NET_APP_CLIENT=y
CONFIG_NET_APP_TLS=n
# CONFIG_NET_APP_DTLS is not set
# CONFIG_NET_APP_TLS_STACK_SIZE=8192
# CONFIG_NET_SOCKETS is not set
# CONFIG_TLS_CREDENTIALS is not set
# CONFIG_CONSOLE_SHELL is not set

CONFIG_ETH_INIT_PRIORITY=80
CONFIG_ETH_ENC28J60=y
CONFIG_ETH_ENC28J60_RX_THREAD_STACK_SIZE=800
CONFIG_ETH_ENC28J60_RX_THREAD_PRIO=2
CONFIG_ETH_EN28J60_TIMEOUT=100
CONFIG_ETH_ENC28J60_0=y
CONFIG_ETH_ENC28J60_0_NAME="ETH_0"
CONFIG_ETH_EN28J60_0_FULL_DUPLEX=y
CONFIG_ETH_ENC28J60_0_GPIO_PORT_NAME="GPIO_0"
CONFIG_ETH_ENC28J60_0_GPIO_PIN=30
CONFIG_ETH_ENC28J60_0_SPI_PORT_NAME="SPI_0"
CONFIG_ETH_ENC28J60_0_SLAVE=26
CONFIG_ETH_ENC28J60_0_GPIO_SPI_CS=y
CONFIG_ETH_ENC28J60_0_SPI_CS_PORT_NAME="GPIO_0"
CONFIG_ETH_ENC28J60_0_SPI_CS_PIN=26
CONFIG_ETH_ENC28J60_0_SPI_BUS_FREQ=1000000
CONFIG_ETH_ENC28J60_0_MAC3=0
CONFIG_ETH_ENC28J60_0_MAC4=0
CONFIG_ETH_ENC28J60_0_MAC5=0
# CONFIG_ETH_DW is not set
# CONFIG_ETH_STM32_HAL is not set
```
